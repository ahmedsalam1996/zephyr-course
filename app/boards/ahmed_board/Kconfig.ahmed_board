## app/boards/ahmed_board/Kconfig.ahmed_board
```kconfig
# Copyright (c) 2020 STMicroelectronics
# SPDX-License-Identifier: Apache-2.0

config BOARD_AHMED_BOARD
	select SOC_STM32L4S5XX
```

## app/boards/ahmed_board/board.yml
```yaml
board:
  name: ahmed_board
  full_name: ahmed_board_IOT Discovery kit
  vendor: globbiz
  socs:
    - name: stm32l4s5xx
```

## app/boards/glasbox_board/board.yml
```yaml
board:
  name: glasbox_board
  full_name: glasbox board from scratch
  vendor: glasbox
  socs: 
    - name: stm32l4s5xx
```
