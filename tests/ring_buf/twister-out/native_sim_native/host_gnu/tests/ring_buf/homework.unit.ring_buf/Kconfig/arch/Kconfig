## tests/ring_buf/twister-out/native_sim_native/host_gnu/tests/ring_buf/homework.unit.ring_buf/Kconfig/arch/Kconfig
```kconfig
# Load Zephyr Arch Kconfig descriptions.
osource "/mnt/c/Users/Ahmed/demo/zephyr-course/zephyr/arch/rx/Kconfig"
osource "/mnt/c/Users/Ahmed/demo/zephyr-course/zephyr/arch/x86/Kconfig"
osource "/mnt/c/Users/Ahmed/demo/zephyr-course/zephyr/arch/xtensa/Kconfig"
osource "/mnt/c/Users/Ahmed/demo/zephyr-course/zephyr/arch/sparc/Kconfig"
osource "/mnt/c/Users/Ahmed/demo/zephyr-course/zephyr/arch/riscv/Kconfig"
osource "/mnt/c/Users/Ahmed/demo/zephyr-course/zephyr/arch/posix/Kconfig"
osource "/mnt/c/Users/Ahmed/demo/zephyr-course/zephyr/arch/openrisc/Kconfig"
osource "/mnt/c/Users/Ahmed/demo/zephyr-course/zephyr/arch/mips/Kconfig"
osource "/mnt/c/Users/Ahmed/demo/zephyr-course/zephyr/arch/arm64/Kconfig"
osource "/mnt/c/Users/Ahmed/demo/zephyr-course/zephyr/arch/arm/Kconfig"
osource "/mnt/c/Users/Ahmed/demo/zephyr-course/zephyr/arch/arc/Kconfig"
```

## tests/ring_buf/twister-out/native_sim_native/host_gnu/tests/ring_buf/homework.unit.ring_buf/Kconfig/boards/Kconfig.defconfig
```kconfig
# Load Zephyr board defconfig descriptions.
osource "/mnt/c/Users/Ahmed/demo/zephyr-course/zephyr/boards/native/native_sim/Kconfig.defconfig"
```

## tests/ring_buf/twister-out/native_sim_native/host_gnu/tests/ring_buf/homework.unit.ring_buf/Kconfig/boards/Kconfig.native_sim
```kconfig
# Load board Kconfig descriptions.
osource "/mnt/c/Users/Ahmed/demo/zephyr-course/zephyr/boards/native/native_sim/Kconfig.native_sim"
```

## tests/ring_buf/twister-out/native_sim_native/host_gnu/tests/ring_buf/homework.unit.ring_buf/Kconfig/soc/Kconfig
```kconfig
# Load Zephyr SoC Kconfig descriptions.
osource "/mnt/c/Users/Ahmed/demo/zephyr-course/zephyr/soc/xlnx/zynqmp/Kconfig"
osource "/mnt/c/Users/Ahmed/demo/zephyr-course/zephyr/soc/xlnx/zynq7000/Kconfig"
osource "/mnt/c/Users/Ahmed/demo/zephyr-course/zephyr/soc/xlnx/versalnet/Kconfig"
osource "/mnt/c/Users/Ahmed/demo/zephyr-course/zephyr/soc/xlnx/versal2/Kconfig"
osource "/mnt/c/Users/Ahmed/demo/zephyr-course/zephyr/soc/xlnx/versal/Kconfig"
osource "/mnt/c/Users/Ahmed/demo/zephyr-course/zephyr/soc/xen/Kconfig"
osource "/mnt/c/Users/Ahmed/demo/zephyr-course/zephyr/soc/wch/ch32v/Kconfig"
osource "/mnt/c/Users/Ahmed/demo/zephyr-course/zephyr/soc/ti/simplelink/Kconfig"
osource "/mnt/c/Users/Ahmed/demo/zephyr-course/zephyr/soc/ti/mspm0/Kconfig"
osource "/mnt/c/Users/Ahmed/demo/zephyr-course/zephyr/soc/ti/lm3s6965/Kconfig"
osource "/mnt/c/Users/Ahmed/demo/zephyr-course/zephyr/soc/ti/k3/Kconfig"
osource "/mnt/c/Users/Ahmed/demo/zephyr-course/zephyr/soc/telink/tlsr/Kconfig"
osource "/mnt/c/Users/Ahmed/demo/zephyr-course/zephyr/soc/syna/sr100/Kconfig"
osource "/mnt/c/Users/Ahmed/demo/zephyr-course/zephyr/soc/starfive/jh71xx/Kconfig"
osource "/mnt/c/Users/Ahmed/demo/zephyr-course/zephyr/soc/st/stm32/Kconfig"
osource "/mnt/c/Users/Ahmed/demo/zephyr-course/zephyr/soc/snps/qemu_arc/Kconfig"
osource "/mnt/c/Users/Ahmed/demo/zephyr-course/zephyr/soc/snps/nsim/arc_v/Kconfig"
osource "/mnt/c/Users/Ahmed/demo/zephyr-course/zephyr/soc/snps/nsim/arc_classic/Kconfig"
osource "/mnt/c/Users/Ahmed/demo/zephyr-course/zephyr/soc/snps/hsdk4xd/Kconfig"
osource "/mnt/c/Users/Ahmed/demo/zephyr-course/zephyr/soc/snps/hsdk/Kconfig"
osource "/mnt/c/Users/Ahmed/demo/zephyr-course/zephyr/soc/snps/emsk/Kconfig"
osource "/mnt/c/Users/Ahmed/demo/zephyr-course/zephyr/soc/snps/emsdp/Kconfig"
osource "/mnt/c/Users/Ahmed/demo/zephyr-course/zephyr/soc/snps/arc_iot/Kconfig"
osource "/mnt/c/Users/Ahmed/demo/zephyr-course/zephyr/soc/silabs/Kconfig"
osource "/mnt/c/Users/Ahmed/demo/zephyr-course/zephyr/soc/sifli/sf32/Kconfig"
osource "/mnt/c/Users/Ahmed/demo/zephyr-course/zephyr/soc/sifive/sifive_freedom/Kconfig"
osource "/mnt/c/Users/Ahmed/demo/zephyr-course/zephyr/soc/sensry/Kconfig"
osource "/mnt/c/Users/Ahmed/demo/zephyr-course/zephyr/soc/rockchip/Kconfig"
osource "/mnt/c/Users/Ahmed/demo/zephyr-course/zephyr/soc/renode/riscv_virtual/Kconfig"
osource "/mnt/c/Users/Ahmed/demo/zephyr-course/zephyr/soc/renode/cortex_r8_virtual/Kconfig"
osource "/mnt/c/Users/Ahmed/demo/zephyr-course/zephyr/soc/renesas/smartbond/Kconfig"
osource "/mnt/c/Users/Ahmed/demo/zephyr-course/zephyr/soc/renesas/rz/Kconfig"
osource "/mnt/c/Users/Ahmed/demo/zephyr-course/zephyr/soc/renesas/rx/Kconfig"
osource "/mnt/c/Users/Ahmed/demo/zephyr-course/zephyr/soc/renesas/rcar/Kconfig"
osource "/mnt/c/Users/Ahmed/demo/zephyr-course/zephyr/soc/renesas/ra/Kconfig"
osource "/mnt/c/Users/Ahmed/demo/zephyr-course/zephyr/soc/realtek/fingerprint/Kconfig"
osource "/mnt/c/Users/Ahmed/demo/zephyr-course/zephyr/soc/realtek/ec/Kconfig"
osource "/mnt/c/Users/Ahmed/demo/zephyr-course/zephyr/soc/realtek/bee/Kconfig"
osource "/mnt/c/Users/Ahmed/demo/zephyr-course/zephyr/soc/realtek/ameba/Kconfig"
osource "/mnt/c/Users/Ahmed/demo/zephyr-course/zephyr/soc/raspberrypi/rpi_pico/Kconfig"
osource "/mnt/c/Users/Ahmed/demo/zephyr-course/zephyr/soc/quicklogic/eos_s3/Kconfig"
osource "/mnt/c/Users/Ahmed/demo/zephyr-course/zephyr/soc/qemu/virt_riscv/Kconfig"
osource "/mnt/c/Users/Ahmed/demo/zephyr-course/zephyr/soc/qemu/or1k/Kconfig"
osource "/mnt/c/Users/Ahmed/demo/zephyr-course/zephyr/soc/qemu/malta/Kconfig"
osource "/mnt/c/Users/Ahmed/demo/zephyr-course/zephyr/soc/openisa/rv32m1/Kconfig"
osource "/mnt/c/Users/Ahmed/demo/zephyr-course/zephyr/soc/openhwgroup/cva6/Kconfig"
osource "/mnt/c/Users/Ahmed/demo/zephyr-course/zephyr/soc/oct/osd32mp15x/Kconfig"
osource "/mnt/c/Users/Ahmed/demo/zephyr-course/zephyr/soc/nxp/s32/Kconfig"
osource "/mnt/c/Users/Ahmed/demo/zephyr-course/zephyr/soc/nxp/rw/Kconfig"
osource "/mnt/c/Users/Ahmed/demo/zephyr-course/zephyr/soc/nxp/mcx/Kconfig"
osource "/mnt/c/Users/Ahmed/demo/zephyr-course/zephyr/soc/nxp/lpc/Kconfig"
osource "/mnt/c/Users/Ahmed/demo/zephyr-course/zephyr/soc/nxp/layerscape/Kconfig"
osource "/mnt/c/Users/Ahmed/demo/zephyr-course/zephyr/soc/nxp/kinetis/Kconfig"
osource "/mnt/c/Users/Ahmed/demo/zephyr-course/zephyr/soc/nxp/imxrt/Kconfig"
osource "/mnt/c/Users/Ahmed/demo/zephyr-course/zephyr/soc/nxp/imx/Kconfig"
osource "/mnt/c/Users/Ahmed/demo/zephyr-course/zephyr/soc/nuvoton/numicro/Kconfig"
osource "/mnt/c/Users/Ahmed/demo/zephyr-course/zephyr/soc/nuvoton/numaker/Kconfig"
osource "/mnt/c/Users/Ahmed/demo/zephyr-course/zephyr/soc/nuvoton/npcx/Kconfig"
osource "/mnt/c/Users/Ahmed/demo/zephyr-course/zephyr/soc/nuvoton/npcm/Kconfig"
osource "/mnt/c/Users/Ahmed/demo/zephyr-course/zephyr/soc/nordic/Kconfig"
osource "/mnt/c/Users/Ahmed/demo/zephyr-course/zephyr/soc/neorv32/Kconfig"
osource "/mnt/c/Users/Ahmed/demo/zephyr-course/zephyr/soc/native/inf_clock/Kconfig"
osource "/mnt/c/Users/Ahmed/demo/zephyr-course/zephyr/soc/microchip/sam/sama7/Kconfig"
osource "/mnt/c/Users/Ahmed/demo/zephyr-course/zephyr/soc/microchip/sam/sam_d5x_e5x/Kconfig"
osource "/mnt/c/Users/Ahmed/demo/zephyr-course/zephyr/soc/microchip/pic64/Kconfig"
osource "/mnt/c/Users/Ahmed/demo/zephyr-course/zephyr/soc/microchip/pic32c/pic32cz_ca/Kconfig"
osource "/mnt/c/Users/Ahmed/demo/zephyr-course/zephyr/soc/microchip/pic32c/pic32cx_sg/Kconfig"
osource "/mnt/c/Users/Ahmed/demo/zephyr-course/zephyr/soc/microchip/pic32c/pic32cm_pl/Kconfig"
osource "/mnt/c/Users/Ahmed/demo/zephyr-course/zephyr/soc/microchip/pic32c/pic32cm_jh/Kconfig"
osource "/mnt/c/Users/Ahmed/demo/zephyr-course/zephyr/soc/microchip/miv/Kconfig"
osource "/mnt/c/Users/Ahmed/demo/zephyr-course/zephyr/soc/microchip/mec/Kconfig"
osource "/mnt/c/Users/Ahmed/demo/zephyr-course/zephyr/soc/mediatek/mt8xxx/Kconfig"
osource "/mnt/c/Users/Ahmed/demo/zephyr-course/zephyr/soc/lowrisc/opentitan/Kconfig"
osource "/mnt/c/Users/Ahmed/demo/zephyr-course/zephyr/soc/litex/Kconfig"
osource "/mnt/c/Users/Ahmed/demo/zephyr-course/zephyr/soc/ite/ec/Kconfig"
osource "/mnt/c/Users/Ahmed/demo/zephyr-course/zephyr/soc/intel/wildcat_lake/Kconfig"
osource "/mnt/c/Users/Ahmed/demo/zephyr-course/zephyr/soc/intel/raptor_lake/Kconfig"
osource "/mnt/c/Users/Ahmed/demo/zephyr-course/zephyr/soc/intel/panther_lake/Kconfig"
osource "/mnt/c/Users/Ahmed/demo/zephyr-course/zephyr/soc/intel/lakemont/Kconfig"
osource "/mnt/c/Users/Ahmed/demo/zephyr-course/zephyr/soc/intel/intel_socfpga_std/Kconfig"
osource "/mnt/c/Users/Ahmed/demo/zephyr-course/zephyr/soc/intel/intel_socfpga/Kconfig"
osource "/mnt/c/Users/Ahmed/demo/zephyr-course/zephyr/soc/intel/intel_niosv/Kconfig"
osource "/mnt/c/Users/Ahmed/demo/zephyr-course/zephyr/soc/intel/intel_ish/Kconfig"
osource "/mnt/c/Users/Ahmed/demo/zephyr-course/zephyr/soc/intel/intel_adsp/Kconfig"
osource "/mnt/c/Users/Ahmed/demo/zephyr-course/zephyr/soc/intel/elkhart_lake/Kconfig"
osource "/mnt/c/Users/Ahmed/demo/zephyr-course/zephyr/soc/intel/atom/Kconfig"
osource "/mnt/c/Users/Ahmed/demo/zephyr-course/zephyr/soc/intel/apollo_lake/Kconfig"
osource "/mnt/c/Users/Ahmed/demo/zephyr-course/zephyr/soc/intel/alder_lake/Kconfig"
osource "/mnt/c/Users/Ahmed/demo/zephyr-course/zephyr/soc/infineon/psoc4/Kconfig"
osource "/mnt/c/Users/Ahmed/demo/zephyr-course/zephyr/soc/infineon/edge/Kconfig"
osource "/mnt/c/Users/Ahmed/demo/zephyr-course/zephyr/soc/infineon/cat3/Kconfig"
osource "/mnt/c/Users/Ahmed/demo/zephyr-course/zephyr/soc/infineon/cat1c/Kconfig"
osource "/mnt/c/Users/Ahmed/demo/zephyr-course/zephyr/soc/infineon/cat1b/Kconfig"
osource "/mnt/c/Users/Ahmed/demo/zephyr-course/zephyr/soc/infineon/cat1a/Kconfig"
osource "/mnt/c/Users/Ahmed/demo/zephyr-course/zephyr/soc/gd/gd32/Kconfig"
osource "/mnt/c/Users/Ahmed/demo/zephyr-course/zephyr/soc/gaisler/leon3/Kconfig"
osource "/mnt/c/Users/Ahmed/demo/zephyr-course/zephyr/soc/gaisler/gr716a/Kconfig"
osource "/mnt/c/Users/Ahmed/demo/zephyr-course/zephyr/soc/focaltech/Kconfig"
osource "/mnt/c/Users/Ahmed/demo/zephyr-course/zephyr/soc/espressif/Kconfig"
osource "/mnt/c/Users/Ahmed/demo/zephyr-course/zephyr/soc/ene/kb1200/Kconfig"
osource "/mnt/c/Users/Ahmed/demo/zephyr-course/zephyr/soc/ene/kb106x/Kconfig"
osource "/mnt/c/Users/Ahmed/demo/zephyr-course/zephyr/soc/elan/em32f967/Kconfig"
osource "/mnt/c/Users/Ahmed/demo/zephyr-course/zephyr/soc/egis/Kconfig"
osource "/mnt/c/Users/Ahmed/demo/zephyr-course/zephyr/soc/efinix/sapphire/Kconfig"
osource "/mnt/c/Users/Ahmed/demo/zephyr-course/zephyr/soc/cdns/xtensa_sample_controller/Kconfig"
osource "/mnt/c/Users/Ahmed/demo/zephyr-course/zephyr/soc/cdns/swerv/Kconfig"
osource "/mnt/c/Users/Ahmed/demo/zephyr-course/zephyr/soc/cdns/sample_controller32/Kconfig"
osource "/mnt/c/Users/Ahmed/demo/zephyr-course/zephyr/soc/cdns/dc233c/Kconfig"
osource "/mnt/c/Users/Ahmed/demo/zephyr-course/zephyr/soc/brcm/bcmvk/Kconfig"
osource "/mnt/c/Users/Ahmed/demo/zephyr-course/zephyr/soc/brcm/bcm2712/Kconfig"
osource "/mnt/c/Users/Ahmed/demo/zephyr-course/zephyr/soc/brcm/bcm2711/Kconfig"
osource "/mnt/c/Users/Ahmed/demo/zephyr-course/zephyr/soc/blackberry/qnxhv_vm/Kconfig"
osource "/mnt/c/Users/Ahmed/demo/zephyr-course/zephyr/soc/bflb/Kconfig"
osource "/mnt/c/Users/Ahmed/demo/zephyr-course/zephyr/soc/atmel/sam0/Kconfig"
osource "/mnt/c/Users/Ahmed/demo/zephyr-course/zephyr/soc/atmel/sam/Kconfig"
osource "/mnt/c/Users/Ahmed/demo/zephyr-course/zephyr/soc/aspeed/Kconfig"
osource "/mnt/c/Users/Ahmed/demo/zephyr-course/zephyr/soc/arm/Kconfig"
osource "/mnt/c/Users/Ahmed/demo/zephyr-course/zephyr/soc/arm/beetle/Kconfig"
osource "/mnt/c/Users/Ahmed/demo/zephyr-course/zephyr/soc/antmicro/myra/Kconfig"
osource "/mnt/c/Users/Ahmed/demo/zephyr-course/zephyr/soc/andestech/Kconfig"
osource "/mnt/c/Users/Ahmed/demo/zephyr-course/zephyr/soc/amd/acp_7_0/Kconfig"
osource "/mnt/c/Users/Ahmed/demo/zephyr-course/zephyr/soc/amd/acp_6_0/Kconfig"
osource "/mnt/c/Users/Ahmed/demo/zephyr-course/zephyr/soc/ambiq/Kconfig"
osource "/mnt/c/Users/Ahmed/demo/zephyr-course/zephyr/soc/allwinner/sun8i_h3/Kconfig"
osource "/mnt/c/Users/Ahmed/demo/zephyr-course/zephyr/soc/alif/ensemble/Kconfig"
osource "/mnt/c/Users/Ahmed/demo/zephyr-course/zephyr/soc/alif/balletto/Kconfig"
osource "/mnt/c/Users/Ahmed/demo/zephyr-course/zephyr/soc/aesc/Kconfig"
osource "/mnt/c/Users/Ahmed/demo/zephyr-course/zephyr/soc/adi/max32/Kconfig"
```

## twister-out/native_sim_native/host_gnu/zephyr-course/tests/ring_buf/homework.unit.ring_buf/Kconfig/boards/Kconfig.defconfig.tmp
```kconfig
# Load Zephyr board defconfig descriptions.
osource "/home/ahmed/zephyr-workspace/deps/zephyr/boards/native/native_sim/Kconfig.defconfig"
```

## twister-out/native_sim_native/host_gnu/zephyr-course/tests/ring_buf/homework.unit.ring_buf/Kconfig/boards/Kconfig.native_sim
```kconfig
# Load board Kconfig descriptions.
osource "/home/ahmed/zephyr-workspace/deps/zephyr/boards/native/native_sim/Kconfig.native_sim"
```

## twister-out/native_sim_native/host_gnu/zephyr-course/tests/ring_buf/homework.unit.ring_buf/Kconfig/boards/Kconfig.sysbuild.tmp
```kconfig
# Load Sysbuild board Kconfig descriptions.
osource "/home/ahmed/zephyr-workspace/deps/zephyr/boards/native/native_sim/Kconfig.sysbuild"
```

## twister-out/native_sim_native/host_gnu/zephyr-course/tests/ring_buf/homework.unit.ring_buf/Kconfig/boards/Kconfig.tmp
```kconfig
# Load Zephyr board Kconfig descriptions.
osource "/home/ahmed/zephyr-workspace/deps/zephyr/boards/native/native_sim/Kconfig"
```
